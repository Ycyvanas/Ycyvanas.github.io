## docs/fusang_embedding/ycycam-udp-demo/sdkconfig.defaults
```kconfig
# ========== ESP32-S3N16R8 高性能配置 ==========
CONFIG_IDF_TARGET="esp32s3"

# ========== 8MB Octal PSRAM 正确配置 (防彩虹噪点优化) ==========
CONFIG_SPIRAM=y
CONFIG_SPIRAM_MODE_OCT=y
CONFIG_SPIRAM_TYPE_AUTO=y
CONFIG_SPIRAM_SPEED_40M=y          # PSRAM降速到40MHz，避免80MHz时和摄像头DVP/SPI总线时序冲突

# ========== PSRAM 高级配置 ==========
CONFIG_SPIRAM_BOOT_INIT=y
CONFIG_SPIRAM_USE_MALLOC=y
CONFIG_SPIRAM_MALLOC_ALWAYSINTERNAL=32768  # 增加内部DRAM分配阈值
CONFIG_SPIRAM_MALLOC_RESERVE_INTERNAL=65536 # 保留更多DRAM给关键外设
CONFIG_SPIRAM_IGNORE_NOTFOUND=y
CONFIG_SPIRAM_MEMTEST=y
CONFIG_SPIRAM_TRY_ALLOCATE_WIFI_LWIP=y

# ========== CPU 配置 ==========
CONFIG_ESP32S3_DEFAULT_CPU_FREQ_240=y
CONFIG_ESP32S3_DEFAULT_CPU_FREQ_MHZ=240

# ========== Flash 16MB 配置 ==========
CONFIG_ESPTOOLPY_FLASHSIZE_16MB=y
CONFIG_ESPTOOLPY_FLASHSIZE="16MB"
CONFIG_PARTITION_TABLE_SINGLE_APP=y

# ========== 串口 配置 ==========
CONFIG_ESP_CONSOLE_UART_DEFAULT=y
CONFIG_ESP_CONSOLE_UART_NUM=0
CONFIG_ESP_CONSOLE_UART_BAUDRATE=115200

# ========== 日志配置 ==========
CONFIG_LOG_DEFAULT_LEVEL_INFO=y
CONFIG_LOG_MAXIMUM_LEVEL_INFO=y

# ========== SPI 优化 ==========
CONFIG_SPI_MASTER_ISR_IN_IRAM=y

# ========== FreeRTOS 优化 ==========
CONFIG_FREERTOS_HZ=1000
CONFIG_FREERTOS_USE_TICKLESS_IDLE=n
CONFIG_FREERTOS_OPTIMIZED_SCHEDULER=y
```
